## conf/bblayers.conf
```bitbake
# LAYER_CONF_VERSION is increased each time build/conf/bblayers.conf
# changes incompatibly
LCONF_VERSION = "6"
TOPDIR := "${@os.path.dirname(os.path.dirname(d.getVar('FILE', True)))}"

BBPATH = "${TOPDIR}"

BBFILES = ""

# These layers hold recipe metadata not found in OE-core, but lack any machine or distro content
BASELAYERS ?= " \
  ${TOPDIR}/sources/openembedded-core/meta \
  ${TOPDIR}/sources/meta-openembedded/meta-xfce \
  ${TOPDIR}/sources/meta-openembedded/meta-oe \
  ${TOPDIR}/sources/meta-openembedded/meta-gnome \
  ${TOPDIR}/sources/meta-openembedded/meta-networking \
  ${TOPDIR}/sources/meta-openembedded/meta-python \
  ${TOPDIR}/sources/meta-java \
  ${TOPDIR}/sources/meta-selinux \
"

# These layers hold machine specific content, aka Board Support Packages
BSPLAYERS ?= " \
  ${TOPDIR}/sources/meta-intel \
"

# Add your overlay location to EXTRALAYERS
# Make sure to have a conf/layers.conf in there
EXTRALAYERS ?= " \
  ${TOPDIR}/sources/xenclient-oe \
"

BBLAYERS = " \
  ${BASELAYERS} \
  ${BSPLAYERS} \
  ${EXTRALAYERS} \
  "
```

## conf/local.conf
```bitbake
# CONF_VERSION is increased each time build/conf/ changes incompatibly
CONF_VERSION = "1"

# Make use of SMP:
#   PARALLEL_MAKE specifies how many concurrent compiler threads are spawned per bitbake process
#   BB_NUMBER_THREADS specifies how many concurrent bitbake tasks will be run
PARALLEL_MAKE     = "-j6"
BB_NUMBER_THREADS = "6"

DISTRO = "openxt-main"

#MIRRORS += "\
#ftp://sources.redhat.com/pub/(lvm2/old/).* http://mirrors.kernel.org/sourceware/\1 \n \
#ftp://invisible-island.net/dialog/.*  http://invisible-mirror.net/archives/dialog/ \n \
#ftp://ftp.debian.org/(.*)  http://ftp.us.debian.org/\1 \n \
#http://rsyslog.com/.* http://iweb.dl.sourceforge.net/project/rsyslog/ \n \
#http://www.haskell.org/ghc/dist/6.12.1/.* http://downloads.haskell.org/~ghc/6.12.1/ \n \
#"

#
# Shared-state files from other locations
#
# Shared state files are prebuilt cache data objects which can 
# used to accelerate build time. This variable can be used to configure the system
# to search other mirror locations for these objects before it builds the data itself.
#
# This can be a filesystem directory, or a remote url such as http or ftp. These
# would contain the sstate-cache results from previous builds (possibly from other 
# machines). This variable works like fetcher MIRRORS/PREMIRRORS and points to the 
# cache locations to check for the shared objects.
#SSTATE_MIRRORS ?= "\
#file://.* http://someserver.tld/share/sstate/ \n \
#file://.* file:///some/local/dir/sstate/"

#SSTATE_MIRRORS ?= "\
#file://.* http://dominion.thruhere.net/angstrom/sstate-mirror/ \n "

# enable PR service on build machine itself
# its good for a case when this is the only builder
# generating the feeds
#
#PRSERV_HOST = "localhost:0"
```
